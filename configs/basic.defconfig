## configs/basic.defconfig
```kconfig
CONFIG_TARGET_MULTI_PROFILE=y
CONFIG_TARGET_PER_DEVICE_ROOTFS=y
CONFIG_TARGET_DEVICE_mediatek_filogic_DEVICE_bananapi_bpi-r4-lite=y
CONFIG_TARGET_DEVICE_mediatek_filogic_DEVICE_bananapi_bpi-r4-pro=y
CONFIG_TARGET_DEVICE_mediatek_filogic_DEVICE_mediatek_mt7987a-rfb=y
CONFIG_TARGET_DEVICE_mediatek_filogic_DEVICE_mediatek_mt7988a-rfb=y
CONFIG_TARGET_DEVICE_mediatek_filogic_DEVICE_mediatek_mt7988a-rfb-mxl86252=y
CONFIG_TARGET_DEVICE_mediatek_filogic_DEVICE_mediatek_mt7988d-rfb=y
CONFIG_BUSYBOX_CUSTOM=y
CONFIG_BUSYBOX_CONFIG_TFTP=y
CONFIG_BUSYBOX_CONFIG_FEATURE_TFTP_GET=y
CONFIG_BUSYBOX_CONFIG_FEATURE_TFTP_PUT=y
CONFIG_BUSYBOX_CONFIG_VCONFIG=y
CONFIG_BUSYBOX_CONFIG_MPSTAT=y
CONFIG_COLLECT_KERNEL_DEBUG=y
# CONFIG_KERNEL_DEBUG_INFO_REDUCED is not set
CONFIG_DEBUG=y
CONFIG_PACKAGE_as21xxx-firmware=y
CONFIG_PACKAGE_mt7981-wo-firmware=y
CONFIG_PACKAGE_mt798x-2p5g-phy-firmware-internal=y
CONFIG_PACKAGE_kmod-ipt-conntrack=y
CONFIG_PACKAGE_kmod-ipt-extra=y
CONFIG_PACKAGE_kmod-ipt-nat=y
CONFIG_PACKAGE_kmod-ipt-offload=y
CONFIG_PACKAGE_kmod-phy-airoha-an8801sb=y
CONFIG_PACKAGE_kmod-phy-aquantia=y
CONFIG_PACKAGE_kmod-sfp=y
CONFIG_PACKAGE_kmod-mt7915e=y
CONFIG_PACKAGE_kmod-mt7981-firmware=y
CONFIG_PACKAGE_kmod-mt798x-2p5g-phy=y
CONFIG_PACKAGE_ephy-utils=y
CONFIG_PACKAGE_ethtool-full=y
CONFIG_PACKAGE_fio=y
CONFIG_PACKAGE_regs=y
CONFIG_PACKAGE_ip6tables-zz-legacy=y
CONFIG_PACKAGE_iptables-mod-ipopt=y
CONFIG_PACKAGE_iptables-zz-legacy=y
CONFIG_PACKAGE_ip-bridge=y
CONFIG_PACKAGE_ip-full=y
CONFIG_PACKAGE_iperf3=y
CONFIG_PACKAGE_lsblk=y
CONFIG_PACKAGE_lm-sensors=y
CONFIG_PACKAGE_mii_mgr=y
CONFIG_PACKAGE_mmc-utils=y
CONFIG_PACKAGE_mtk_factory_rw=y
CONFIG_PACKAGE_mtkhnat_util=y
CONFIG_PACKAGE_netsys_dbg_util=y
CONFIG_PACKAGE_sfdisk=y
CONFIG_PACKAGE_switch=y
CONFIG_PACKAGE_tcpdump=y
CONFIG_PACKAGE_rpcd-mod-iwinfo=y
CONFIG_PACKAGE_libiwinfo-data=y
CONFIG_PACKAGE_kmod-crypto-crc32=y
CONFIG_PACKAGE_kmod-fs-f2fs=y
CONFIG_PACKAGE_lua=y
# CONFIG_PACKAGE_lua-examples is not set
CONFIG_PACKAGE_libcap=y
# CONFIG_PACKAGE_libcap-bin is not set
CONFIG_PACKAGE_libiwinfo=y
CONFIG_PACKAGE_liblua=y
CONFIG_PACKAGE_liblucihttp-lua=y
CONFIG_PACKAGE_libubus-lua=y
CONFIG_PACKAGE_libuv=y
CONFIG_PACKAGE_libwebsockets-full=y
CONFIG_PACKAGE_rpcd-mod-rrdns=y
CONFIG_PACKAGE_luci=y
CONFIG_PACKAGE_luci-light=y
CONFIG_PACKAGE_luci-compat=y
CONFIG_PACKAGE_luci-lua-runtime=y
CONFIG_PACKAGE_luci-mod-admin-full=y
CONFIG_PACKAGE_luci-mod-network=y
CONFIG_PACKAGE_luci-mod-status=y
CONFIG_PACKAGE_luci-mod-system=y
CONFIG_PACKAGE_luci-app-firewall=y
CONFIG_PACKAGE_luci-app-package-manager=y
CONFIG_PACKAGE_luci-app-ttyd=y
CONFIG_PACKAGE_luci-theme-bootstrap=y
CONFIG_PACKAGE_luci-proto-ipv6=y
CONFIG_PACKAGE_luci-proto-ppp=y
CONFIG_PACKAGE_luci-lib-base=y
CONFIG_PACKAGE_luci-lib-ip=y
CONFIG_PACKAGE_luci-lib-jsonc=y
CONFIG_PACKAGE_luci-lib-nixio=y
# CONFIG_PACKAGE_luci-i18n-firewall-ar is not set
# CONFIG_PACKAGE_luci-i18n-firewall-bg is not set
# CONFIG_PACKAGE_luci-i18n-firewall-bn is not set
# CONFIG_PACKAGE_luci-i18n-firewall-ca is not set
# CONFIG_PACKAGE_luci-i18n-firewall-cs is not set
# CONFIG_PACKAGE_luci-i18n-firewall-da is not set
# CONFIG_PACKAGE_luci-i18n-firewall-de is not set
# CONFIG_PACKAGE_luci-i18n-firewall-el is not set
# CONFIG_PACKAGE_luci-i18n-firewall-es is not set
# CONFIG_PACKAGE_luci-i18n-firewall-fa is not set
# CONFIG_PACKAGE_luci-i18n-firewall-fi is not set
# CONFIG_PACKAGE_luci-i18n-firewall-fr is not set
# CONFIG_PACKAGE_luci-i18n-firewall-ga is not set
# CONFIG_PACKAGE_luci-i18n-firewall-he is not set
# CONFIG_PACKAGE_luci-i18n-firewall-hi is not set
# CONFIG_PACKAGE_luci-i18n-firewall-hu is not set
# CONFIG_PACKAGE_luci-i18n-firewall-it is not set
# CONFIG_PACKAGE_luci-i18n-firewall-ja is not set
# CONFIG_PACKAGE_luci-i18n-firewall-ko is not set
# CONFIG_PACKAGE_luci-i18n-firewall-lt is not set
# CONFIG_PACKAGE_luci-i18n-firewall-mr is not set
# CONFIG_PACKAGE_luci-i18n-firewall-ms is not set
# CONFIG_PACKAGE_luci-i18n-firewall-nl is not set
# CONFIG_PACKAGE_luci-i18n-firewall-no is not set
# CONFIG_PACKAGE_luci-i18n-firewall-pl is not set
# CONFIG_PACKAGE_luci-i18n-firewall-pt is not set
# CONFIG_PACKAGE_luci-i18n-firewall-pt-br is not set
# CONFIG_PACKAGE_luci-i18n-firewall-ro is not set
# CONFIG_PACKAGE_luci-i18n-firewall-ru is not set
# CONFIG_PACKAGE_luci-i18n-firewall-sk is not set
# CONFIG_PACKAGE_luci-i18n-firewall-sv is not set
# CONFIG_PACKAGE_luci-i18n-firewall-ta is not set
# CONFIG_PACKAGE_luci-i18n-firewall-tr is not set
# CONFIG_PACKAGE_luci-i18n-firewall-uk is not set
# CONFIG_PACKAGE_luci-i18n-firewall-vi is not set
# CONFIG_PACKAGE_luci-i18n-firewall-yua is not set
# CONFIG_PACKAGE_luci-i18n-firewall-zh-cn is not set
# CONFIG_PACKAGE_luci-i18n-firewall-zh-tw is not set
# CONFIG_PACKAGE_luci-i18n-package-manager-ar is not set
# CONFIG_PACKAGE_luci-i18n-package-manager-bg is not set
# CONFIG_PACKAGE_luci-i18n-package-manager-bn is not set
# CONFIG_PACKAGE_luci-i18n-package-manager-ca is not set
# CONFIG_PACKAGE_luci-i18n-package-manager-cs is not set
# CONFIG_PACKAGE_luci-i18n-package-manager-da is not set
# CONFIG_PACKAGE_luci-i18n-package-manager-de is not set
# CONFIG_PACKAGE_luci-i18n-package-manager-el is not set
# CONFIG_PACKAGE_luci-i18n-package-manager-es is not set
# CONFIG_PACKAGE_luci-i18n-package-manager-fa is not set
# CONFIG_PACKAGE_luci-i18n-package-manager-fi is not set
# CONFIG_PACKAGE_luci-i18n-package-manager-fr is not set
# CONFIG_PACKAGE_luci-i18n-package-manager-ga is not set
# CONFIG_PACKAGE_luci-i18n-package-manager-he is not set
# CONFIG_PACKAGE_luci-i18n-package-manager-hi is not set
# CONFIG_PACKAGE_luci-i18n-package-manager-hu is not set
# CONFIG_PACKAGE_luci-i18n-package-manager-it is not set
# CONFIG_PACKAGE_luci-i18n-package-manager-ja is not set
# CONFIG_PACKAGE_luci-i18n-package-manager-ko is not set
# CONFIG_PACKAGE_luci-i18n-package-manager-lt is not set
# CONFIG_PACKAGE_luci-i18n-package-manager-mr is not set
# CONFIG_PACKAGE_luci-i18n-package-manager-ms is not set
# CONFIG_PACKAGE_luci-i18n-package-manager-nl is not set
# CONFIG_PACKAGE_luci-i18n-package-manager-no is not set
# CONFIG_PACKAGE_luci-i18n-package-manager-pl is not set
# CONFIG_PACKAGE_luci-i18n-package-manager-pt is not set
# CONFIG_PACKAGE_luci-i18n-package-manager-pt-br is not set
# CONFIG_PACKAGE_luci-i18n-package-manager-ro is not set
# CONFIG_PACKAGE_luci-i18n-package-manager-ru is not set
# CONFIG_PACKAGE_luci-i18n-package-manager-sk is not set
# CONFIG_PACKAGE_luci-i18n-package-manager-sv is not set
# CONFIG_PACKAGE_luci-i18n-package-manager-ta is not set
# CONFIG_PACKAGE_luci-i18n-package-manager-tr is not set
# CONFIG_PACKAGE_luci-i18n-package-manager-uk is not set
# CONFIG_PACKAGE_luci-i18n-package-manager-vi is not set
# CONFIG_PACKAGE_luci-i18n-package-manager-yua is not set
# CONFIG_PACKAGE_luci-i18n-package-manager-zh-cn is not set
# CONFIG_PACKAGE_luci-i18n-package-manager-zh-tw is not set
# CONFIG_PACKAGE_luci-i18n-ttyd-ar is not set
# CONFIG_PACKAGE_luci-i18n-ttyd-bg is not set
# CONFIG_PACKAGE_luci-i18n-ttyd-bn is not set
# CONFIG_PACKAGE_luci-i18n-ttyd-ca is not set
# CONFIG_PACKAGE_luci-i18n-ttyd-cs is not set
# CONFIG_PACKAGE_luci-i18n-ttyd-da is not set
# CONFIG_PACKAGE_luci-i18n-ttyd-de is not set
# CONFIG_PACKAGE_luci-i18n-ttyd-el is not set
# CONFIG_PACKAGE_luci-i18n-ttyd-es is not set
# CONFIG_PACKAGE_luci-i18n-ttyd-fi is not set
# CONFIG_PACKAGE_luci-i18n-ttyd-fr is not set
# CONFIG_PACKAGE_luci-i18n-ttyd-ga is not set
# CONFIG_PACKAGE_luci-i18n-ttyd-he is not set
# CONFIG_PACKAGE_luci-i18n-ttyd-hi is not set
# CONFIG_PACKAGE_luci-i18n-ttyd-hu is not set
# CONFIG_PACKAGE_luci-i18n-ttyd-it is not set
# CONFIG_PACKAGE_luci-i18n-ttyd-ja is not set
# CONFIG_PACKAGE_luci-i18n-ttyd-ko is not set
# CONFIG_PACKAGE_luci-i18n-ttyd-lt is not set
# CONFIG_PACKAGE_luci-i18n-ttyd-mr is not set
# CONFIG_PACKAGE_luci-i18n-ttyd-ms is not set
# CONFIG_PACKAGE_luci-i18n-ttyd-nl is not set
# CONFIG_PACKAGE_luci-i18n-ttyd-no is not set
# CONFIG_PACKAGE_luci-i18n-ttyd-pl is not set
# CONFIG_PACKAGE_luci-i18n-ttyd-pt is not set
# CONFIG_PACKAGE_luci-i18n-ttyd-pt-br is not set
# CONFIG_PACKAGE_luci-i18n-ttyd-ro is not set
# CONFIG_PACKAGE_luci-i18n-ttyd-ru is not set
# CONFIG_PACKAGE_luci-i18n-ttyd-sk is not set
# CONFIG_PACKAGE_luci-i18n-ttyd-sv is not set
# CONFIG_PACKAGE_luci-i18n-ttyd-ta is not set
# CONFIG_PACKAGE_luci-i18n-ttyd-tr is not set
# CONFIG_PACKAGE_luci-i18n-ttyd-uk is not set
# CONFIG_PACKAGE_luci-i18n-ttyd-vi is not set
# CONFIG_PACKAGE_luci-i18n-ttyd-zh-cn is not set
# CONFIG_PACKAGE_luci-i18n-ttyd-zh-tw is not set
# CONFIG_PACKAGE_uspot is not set
# CONFIG_PACKAGE_uspot-www is not set
CONFIG_PACKAGE_uhttpd=y
# CONFIG_PACKAGE_uhttpd-mod-lua is not set
CONFIG_PACKAGE_uhttpd-mod-ubus=y
# CONFIG_PACKAGE_uhttpd-mod-ucode is not set
CONFIG_PACKAGE_ttyd=y
CONFIG_PACKAGE_dmesg=y
CONFIG_PACKAGE_ucode-mod-lua=y
```
